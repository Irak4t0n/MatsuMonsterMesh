## components/meshtastic_radio/Kconfig
```kconfig
menu "MatsuMonsterMesh / MeshtasticRadio"

    config MATSUMONSTER_MESH_STUB
        bool "Use StubMeshtasticRadio (no real radio I/O)"
        default y
        help
            When enabled, MatsuMonsterMesh instantiates StubMeshtasticRadio
            in main.c — every send is logged via ESP_LOGI(MMRadio) and
            pollPackets() always returns 0. This lets the project build and
            run on a device whose ESP32-C6 radio coprocessor has not been
            flashed with Meshtastic firmware yet.

            Disable this to instantiate SerialMeshtasticRadio. NOTE: as of
            this Step 4 the serial transport is itself a stub — the Tanmatsu
            P4-to-C6 link is SDIO (BSP_SDIO_* in tanmatsu_hardware.h), not
            UART, so a real implementation requires either a custom
            serial-over-SDIO transport on top of ESP-Hosted, or replacing
            ESP-Hosted on the C6 with Meshtastic firmware that exposes a
            serial endpoint over the SDIO link. See the block comment in
            meshtastic_radio_serial.cpp for the open questions.

endmenu
```

## managed_components/badgeteam__custom-certificates/Kconfig
```kconfig
menu "Custom certificates"
	config CUSTOM_CA_LETSENCRYPT_X1
		bool "Letsencrypt ISRG ROOT X1"
		default y
	config CUSTOM_CA_LETSENCRYPT_X2
		bool "Letsencrypt ISRG ROOT X2"
		default y
	config CUSTOM_CA_BADGETEAM_OTA
		bool "Self-signed: Badge.Team OTA update cloud service"
		default n
	config CUSTOM_CA_MCH2022_OTA
		bool "Self-signed: Badge.Team MCH2022 OTA update cloud service"
		default n
	config CUSTOM_CA_TANMATSU_APPS
		bool "Self-signed: Nicolai Electronics Tanmatsu app repository cloud service"
		default n
	config CUSTOM_CA_TANMATSU_OTA
		bool "Self-signed: Nicolai Electronics Tanmatsu OTA update cloud service"
		default n
endmenu
```
